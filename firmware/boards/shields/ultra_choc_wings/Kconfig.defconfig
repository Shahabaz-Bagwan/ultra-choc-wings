## firmware/boards/shields/ultra_choc_wings/Kconfig.defconfig
```kconfig
if SHIELD_ULTRA_CHOC_WINGS_DONGLE

config ZMK_KEYBOARD_NAME
    default "UltraChocWings"

config ZMK_SPLIT_ROLE_CENTRAL
    default y

# Two peripherals (left and right) plus five host profiles.
config ZMK_SPLIT_BLE_CENTRAL_PERIPHERALS
    default 2

config BT_MAX_CONN
    default 7

config BT_MAX_PAIRED
    default 7

endif

if SHIELD_ULTRA_CHOC_WINGS_DONGLE || SHIELD_ULTRA_CHOC_WINGS_LEFT || SHIELD_ULTRA_CHOC_WINGS_RIGHT

config ZMK_SPLIT
    default y

endif
```

## firmware/boards/shields/ultra_choc_wings/Kconfig.shield
```kconfig
config SHIELD_ULTRA_CHOC_WINGS_DONGLE
    def_bool $(shields_list_contains,ultra_choc_wings_dongle)

config SHIELD_ULTRA_CHOC_WINGS_LEFT
    def_bool $(shields_list_contains,ultra_choc_wings_left)

config SHIELD_ULTRA_CHOC_WINGS_RIGHT
    def_bool $(shields_list_contains,ultra_choc_wings_right)
```
